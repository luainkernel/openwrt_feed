## kernel/lunatik/Config.in
```kconfig
#
# SPDX-FileCopyrightText: (c) 2026 Ring Zero Desenvolvimento de Software LTDA
# SPDX-License-Identifier: MIT OR GPL-2.0-only
#

menu "Lunatik modules"
	depends on PACKAGE_kmod-lunatik

config LUNATIK_BYTEORDER
	bool "Lunatik Byteorder Support"
	default m
	help
	  Byte order swapping functions.

config LUNATIK_COMPLETION
	bool "Lunatik Completion Support"
	default m
	help
	  Kernel completion synchronization primitives.

config LUNATIK_CRYPTO
	bool "Lunatik Crypto Support"
	default m
	help
	  Linux Kernel Crypto API bindings: symmetric ciphers, authenticated
	  encryption, hashing, RNG, and compression.

config LUNATIK_DARKEN
	bool "Lunatik Darken Support"
	default m
	help
	  AES-256-CTR encrypted Lua script execution.

config LUNATIK_DATA
	bool "Lunatik Data Support"
	default m
	help
	  Shared data structures support.

config LUNATIK_DEVICE
	bool "Lunatik Device Support"
	default y if LUNATIK_RUNTIME
	help
	  Allows creating character devices using Lua.

config LUNATIK_FIFO
	bool "Lunatik FIFO Support"
	default m
	help
	  First-In-First-Out queue support.

config LUNATIK_LINUX
	bool "Lunatik Linux API Bindings"
	default m
	help
	  Provides Lua bindings for common Linux kernel functions (random, stat, etc.).

config LUNATIK_NETFILTER
	bool "Lunatik Netfilter bindings"
	default m
	help
	  New Netfilter API bindings.

config LUNATIK_RCU
	bool "Lunatik RCU Support"
	default y if LUNATIK_RUNTIME
	help
	  Read-Copy-Update (RCU) synchronization support.

config LUNATIK_RUN
	bool "Lunatik Run (Execution Support)"
	default y
	help
	  Support for running Lua scripts in the kernel. This is required
	  for basic script execution functionality.

config LUNATIK_RUNTIME
	bool "Lunatik Runtime Environment"
	default y
	select LUNATIK_DEVICE
	select LUNATIK_RCU
	help
	  Enables the core Lunatik runtime environment, allowing creation of
	  isolated Lua states within the kernel. This requires both device
	  and RCU support.

config LUNATIK_SKB
	bool "Lunatik SKB Support"
	default m
	help
	  Linux socket buffer (sk_buff) interface for Lua.

config LUNATIK_SOCKET
	bool "Lunatik Socket Support"
	default m
	help
	  Networking socket support for Lua scripts.

config LUNATIK_THREAD
	bool "Lunatik Thread Support"
	default m
	help
	  Kernel thread management from Lua.

endmenu
```
